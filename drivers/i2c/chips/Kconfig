## drivers/i2c/chips/Kconfig
```kconfig
#
# Miscellaneous I2C chip drivers configuration
#
# *** DEPRECATED! Do not add new entries! See Makefile ***
#

menu "Miscellaneous I2C Chip support"

config SENSORS_MT9T013
	tristate "MT9T013 Camera Driver"
	depends on I2C
	default y
	help
	 MT9T013 Camera Driver implemented by HTC.

config AMP_TPA6130A
	tristate "TI TPA6130A Headset AMP Driver"
	depends on I2C
	help
	 TI TPA6130A Headset AMP Driver implemented by HTC.

endmenu
```
